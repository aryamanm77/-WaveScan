#ifndef WEB_ASSETS_H
#define WEB_ASSETS_H

#include <Arduino.h>

const char INDEX_HTML[] PROGMEM = R"rawliteral(<!DOCTYPE html>
<html lang="en">
<head>
  <meta charset="UTF-8">
  <meta name="viewport" content="width=device-width, initial-scale=1.0, maximum-scale=1.0, user-scalable=no, viewport-fit=cover">
  <meta name="theme-color" content="#292929">
  <meta name="mobile-web-app-capable" content="yes">
  <meta name="apple-mobile-web-app-capable" content="yes">
  <meta name="apple-mobile-web-app-status-bar-style" content="black-translucent">
  <meta name="apple-mobile-web-app-title" content="WΛVΞSCAN">
  <meta name="application-name" content="WΛVΞSCAN">
  <title>WΛVΞSCAN — Wi-Fi Analyzer</title>
  <link rel="manifest" href="/manifest.json">
  <link rel="icon" type="image/svg+xml" href="/icons/icon.svg">
  <link rel="icon" type="image/png" sizes="192x192" href="/icons/icon-192.png">
  <link rel="apple-touch-icon" href="/icons/icon-192.png">
  <link rel="stylesheet" href="style.css?v=5">
</head>
<body>
  <!-- TOP TOOLBAR -->
  <header class="top-toolbar">
    <button class="tb-btn" id="btn-back" title="Back" aria-label="Back">
      <svg viewBox="0 0 24 24" class="tb-icon">
        <path d="M20 11H7.83l5.59-5.59L12 4l-8 8 8 8 1.41-1.41L7.83 13H20v-2z" fill="currentColor"/>
      </svg>
    </button>

    <div class="search-box">
      <svg viewBox="0 0 24 24" class="search-icon">
        <path d="M15.5 14h-.79l-.28-.27A6.471 6.471 0 0 0 16 9.5 6.5 6.5 0 1 0 9.5 16c1.61 0 3.09-.59 4.23-1.57l.27.28v.79l5 4.99L20.49 19l-4.99-5zm-6 0C7.01 14 5 11.99 5 9.5S7.01 5 9.5 5 14 7.01 14 9.5 11.99 14 9.5 14z" fill="currentColor"/>
      </svg>
      <input type="text" id="search-input" placeholder="Search SSID..." autocomplete="off" autocorrect="off" autocapitalize="off" spellcheck="false">
      <button class="clear-search-btn" id="btn-clear-search" aria-label="Clear Search">&times;</button>
    </div>

    <button class="tb-btn" id="btn-filter" title="Filter & Options" aria-label="Filter">
      <svg viewBox="0 0 24 24" class="tb-icon">
        <path d="M10 18h4v-2h-4v2zM3 6v2h18V6H3zm3 7h12v-2H6v2z" fill="currentColor"/>
      </svg>
      <span class="filter-indicator" id="filter-indicator"></span>
    </button>
  </header>

  <!-- FILTER & OPTIONS MODAL / POPUP -->
  <div class="modal-overlay" id="filter-modal">
    <div class="filter-menu">
      <div class="filter-header">
        <span class="filter-title">Filter & Sort</span>
        <button class="close-modal-btn" id="btn-close-filter">&times;</button>
      </div>

      <div class="filter-section-title">SECURITY & SIGNAL</div>
      <div class="filter-options">
        <label class="filter-option">
          <input type="radio" name="filter-type" value="all" checked>
          <span class="radio-mark"></span>
          <span>All networks</span>
        </label>
        <label class="filter-option">
          <input type="radio" name="filter-type" value="secured">
          <span class="radio-mark"></span>
          <span>Secured networks</span>
        </label>
        <label class="filter-option">
          <input type="radio" name="filter-type" value="open">
          <span class="radio-mark"></span>
          <span>Open networks</span>
        </label>
        <label class="filter-option">
          <input type="radio" name="filter-type" value="strong">
          <span class="radio-mark"></span>
          <span>Strong signals (&ge; -65 dBm)</span>
        </label>
        <label class="filter-option">
          <input type="radio" name="filter-type" value="weak">
          <span class="radio-mark"></span>
          <span>Weak signals (&lt; -75 dBm)</span>
        </label>
      </div>

      <div class="filter-section-title">SORT BY</div>
      <div class="filter-options">
        <label class="filter-option">
          <input type="radio" name="sort-type" value="rssi" checked>
          <span class="radio-mark"></span>
          <span>Signal Strength (dBm)</span>
        </label>
        <label class="filter-option">
          <input type="radio" name="sort-type" value="ssid">
          <span class="radio-mark"></span>
          <span>Network Name (SSID)</span>
        </label>
        <label class="filter-option">
          <input type="radio" name="sort-type" value="channel">
          <span class="radio-mark"></span>
          <span>Channel Number</span>
        </label>
      </div>

      <div class="filter-actions">
        <button class="action-btn secondary" id="btn-reset-filter">Reset</button>
        <button class="action-btn primary" id="btn-apply-filter">Apply</button>
      </div>
    </div>
  </div>

  <!-- MAIN SCROLLABLE CONTENT AREA -->
  <main class="main-content">
    <!-- SUB-STATUS BAR -->
    <div class="sub-status-bar">
      <div class="status-left">
        <span class="pulse-dot" id="live-dot"></span>
        <span class="app-brand-badge">WΛVΞSCAN</span>
        <span class="status-sep">|</span>
        <span id="network-count-text">Scanning...</span>
      </div>
      <div class="status-right">
        <button class="scan-btn" id="btn-scan-now" title="Trigger Scan">
          <svg viewBox="0 0 24 24" class="btn-icon">
            <path d="M17.65 6.35C16.2 4.9 14.21 4 12 4c-4.42 0-7.99 3.58-7.99 8s3.57 8 7.99 8c3.73 0 6.84-2.55 7.73-6h-2.08c-.82 2.33-3.04 4-5.65 4-3.31 0-6-2.69-6-6s2.69-6 6-6c1.66 0 3.14.69 4.22 1.78L13 11h7V4l-2.35 2.35z" fill="currentColor"/>
          </svg>
          <span id="scan-btn-label">Scan</span>
        </button>
      </div>
    </div>

    <!-- TAB 1: LIST VIEW (DEFAULT) -->
    <section class="tab-view active" id="tab-list">
      <div class="network-list-container" id="network-list">
        <!-- Dense network rows injected here -->
        <div class="empty-state" id="empty-state">
          <div class="spinner"></div>
          <p>Scanning 2.4 GHz Wi-Fi spectrum...</p>
        </div>
      </div>
    </section>

    <!-- TAB 2: CHANNELS VIEW -->
    <section class="tab-view" id="tab-channels">
      <div class="channels-container">
        <div class="section-banner">
          <span class="banner-title">2.4 GHz SPECTRUM DISTRIBUTION</span>
          <span class="banner-sub" id="ch-active-summary">0 Active Channels</span>
        </div>

        <!-- SVG Channel Graph -->
        <div class="spectrum-graph-card">
          <svg id="spectrum-svg" viewBox="0 0 380 200" preserveAspectRatio="none">
            <!-- Channel grid, frequency curves injected by app.js -->
          </svg>
          <div class="spectrum-x-axis">
            <span>1</span><span>2</span><span>3</span><span>4</span><span>5</span><span>6</span><span>7</span><span>8</span><span>9</span><span>10</span><span>11</span><span>12</span><span>13</span><span>14</span>
          </div>
        </div>

        <!-- Channel Congestion Summary List -->
        <div class="channel-breakdown-title">CHANNEL OCCUPANCY</div>
        <div class="channel-cards-list" id="channel-breakdown-list">
          <!-- Channel cards injected by JS -->
        </div>
      </div>
    </section>

    <!-- TAB 3: DISCOVERY VIEW (DETAIL INSPECTOR) -->
    <section class="tab-view" id="tab-discovery">
      <div class="discovery-container">
        <!-- Network Selector Picker -->
        <div class="discovery-picker-row">
          <label for="discovery-select">TARGET NETWORK:</label>
          <select id="discovery-select">
            <option value="">-- Choose a network to inspect --</option>
          </select>
        </div>

        <div id="discovery-details" class="discovery-details-wrap">
          <div class="no-selection-msg">
            <p>Select a network from the List tab or choose above to view deep diagnostic details, signal telemetry, and assign location tags.</p>
          </div>
        </div>
      </div>
    </section>

    <!-- TAB 4: SPEED TEST & DIAGNOSTICS VIEW -->
    <section class="tab-view" id="tab-diagnostics">
      <div class="diagnostics-container">
        <div class="section-banner">
          <span class="banner-title">WΛVΞSCAN HARDWARE & SYSTEM STATUS</span>
          <span class="banner-sub" id="diag-uptime">Uptime: --</span>
        </div>

        <div class="diag-table">
          <div class="diag-row">
            <span class="diag-key">Connection Mode</span>
            <span class="diag-val" id="diag-mode">ESP32 Station (STA)</span>
          </div>
          <div class="diag-row">
            <span class="diag-key">Hotspot / AP SSID</span>
            <span class="diag-val" id="diag-ssid">--</span>
          </div>
          <div class="diag-row">
            <span class="diag-key">ESP32 IP Address</span>
            <span class="diag-val highlight" id="diag-ip">--</span>
          </div>
          <div class="diag-row">
            <span class="diag-key">ESP32 MAC Address</span>
            <span class="diag-val" id="diag-mac">--</span>
          </div>
          <div class="diag-row">
            <span class="diag-key">Free Heap Memory</span>
            <span class="diag-val" id="diag-heap">-- KB</span>
          </div>
          <div class="diag-row">
            <span class="diag-key">Last Scan Duration</span>
            <span class="diag-val" id="diag-duration">-- ms</span>
          </div>
          <div class="diag-row">
            <span class="diag-key">Total APs Detected</span>
            <span class="diag-val" id="diag-total-ap">0</span>
          </div>
        </div>

        <!-- BENCHMARKS & TESTS -->
        <div class="channel-breakdown-title">LINK & SPEED BENCHMARKS</div>

        <div class="diag-card">
          <div class="diag-card-header">
            <span class="diag-card-title">Wi-Fi Link Ping Test</span>
            <span class="diag-card-stat" id="ping-result">-- ms</span>
          </div>
          <p class="diag-card-desc">Measures roundtrip packet latency between this Android phone and the ESP32 microcontroller.</p>
          <button class="action-btn secondary full-width" id="btn-run-ping">Ping ESP32</button>
        </div>

        <div class="diag-card">
          <div class="diag-card-header">
            <span class="diag-card-title">Local Wi-Fi Throughput</span>
            <span class="diag-card-stat" id="throughput-result">-- Mbps</span>
          </div>
          <p class="diag-card-desc">Transfers raw payload over local Wi-Fi to benchmark physical wireless link capacity without burning mobile data.</p>
          <button class="action-btn secondary full-width" id="btn-run-throughput">Test Local Throughput</button>
        </div>

        <!-- EXPORT & STORAGE -->
        <div class="channel-breakdown-title">DATA EXPORT & PWA APP</div>
        <div class="export-actions-row">
          <button class="action-btn success full-width" id="btn-install-pwa">
            <svg viewBox="0 0 24 24" class="btn-icon">
              <path d="M19.35 10.04C18.67 6.59 15.64 4 12 4 9.11 4 6.6 5.64 5.35 8.04 2.34 8.36 0 10.91 0 14c0 3.31 2.69 6 6 6h13c2.76 0 5-2.24 5-5 0-2.64-2.05-4.78-4.65-4.96zM17 13l-5 5-5-5h3V9h4v4h3z" fill="currentColor"/>
            </svg>
            Download / Install WΛVΞSCAN App
          </button>
          <a class="action-btn primary full-width" id="btn-export-csv" href="/api/history.csv" download="wavescan_history.csv">
            <svg viewBox="0 0 24 24" class="btn-icon">
              <path d="M19 9h-4V3H9v6H5l7 7 7-7zM5 18v2h14v-2H5z" fill="currentColor"/>
            </svg>
            Export CSV History
          </a>
          <button class="action-btn danger full-width" id="btn-clear-localstorage">Reset Best RSSI Records</button>
        </div>
      </div>
    </section>
  </main>

  <!-- FIXED BOTTOM NAVIGATION -->
  <nav class="bottom-nav">
    <button class="nav-item active" data-tab="tab-list">
      <svg viewBox="0 0 24 24" class="nav-icon">
        <path d="M4 6h16v2H4zm0 5h16v2H4zm0 5h16v2H4z" fill="currentColor"/>
      </svg>
      <span class="nav-label">List</span>
    </button>

    <button class="nav-item" data-tab="tab-channels">
      <svg viewBox="0 0 24 24" class="nav-icon">
        <path d="M5 9.2h3V19H5zM10.5 5h3v14h-3zm5.5 8h3v6h-3z" fill="currentColor"/>
      </svg>
      <span class="nav-label">Channels</span>
    </button>

    <button class="nav-item" data-tab="tab-discovery">
      <svg viewBox="0 0 24 24" class="nav-icon">
        <path d="M12 2C6.48 2 2 6.48 2 12s4.48 10 10 10 10-4.48 10-10S17.52 2 12 2zm1 17.93c-3.95-.49-7-3.85-7-7.93 0-.62.08-1.21.21-1.79L9 15v1c0 1.1.9 2 2 2v1.93zm6.9-2.54c-.26-.81-1-1.39-1.9-1.39h-1v-3c0-.55-.45-1-1-1H8v-2h2c.55 0 1-.45 1-1V7h2c1.1 0 2-.9 2-2v-.41c2.93 1.19 5 4.06 5 7.41 0 2.08-.8 3.97-2.1 5.39z" fill="currentColor"/>
      </svg>
      <span class="nav-label">Discovery</span>
    </button>

    <button class="nav-item" data-tab="tab-diagnostics">
      <svg viewBox="0 0 24 24" class="nav-icon">
        <path d="M20.38 8.57l-1.23 1.85a8 8 0 0 1-.22 7.58H5.07A8 8 0 0 1 15.58 6.85l1.85-1.23A10 10 0 0 0 3.35 19a2 2 0 0 0 1.72 1h13.85a2 2 0 0 0 1.74-1 10 10 0 0 0-.28-10.43zM10.59 15.41a2 2 0 0 0 2.83 0l5.66-8.49-8.49 5.66a2 2 0 0 0 0 2.83z" fill="currentColor"/>
      </svg>
      <span class="nav-label">Speed Test</span>
    </button>
  </nav>

  <!-- TOAST NOTIFICATION -->
  <div class="toast" id="toast"></div>

  <script src="app.js?v=5"></script>
</body>
</html>
)rawliteral";

const char STYLE_CSS[] PROGMEM = R"rawliteral(/* WAVESCAN — Professional Classic Android Wi-Fi Analyzer Theme */

:root {
  --bg-main: #292929;
  --bg-toolbar: #292929;
  --bg-nav: #20232B;
  --bg-card: #20232B;
  --bg-input: #383838;
  --border-subtle: #3a3a3a;
  --divider: #333333;
  --text-primary: #EEEEEE;
  --text-secondary: #858585;
  --text-muted: #666666;
  --signal-green: #00C99A;
  --signal-yellow: #FFD600;
  --signal-red: #E65345;
  --nav-active: #20BCEB;
  --signal-track: #3b3630;
  --best-marker: #FFFFFF;
  --font-family: -apple-system, BlinkMacSystemFont, "Roboto", "Segoe UI", "Helvetica Neue", Arial, sans-serif;
}

* {
  box-sizing: border-box;
  margin: 0;
  padding: 0;
  -webkit-tap-highlight-color: transparent;
  user-select: none;
}

input, select, textarea {
  user-select: text;
}

html, body {
  width: 100%;
  height: 100%;
  overflow: hidden;
  background-color: var(--bg-main);
  color: var(--text-primary);
  font-family: var(--font-family);
  font-size: 14px;
  line-height: 1.35;
  -webkit-font-smoothing: antialiased;
}

/* TOP TOOLBAR */
.top-toolbar {
  position: fixed;
  top: 0;
  left: 0;
  right: 0;
  height: 52px;
  background-color: var(--bg-toolbar);
  border-bottom: 1px solid #383838;
  display: flex;
  align-items: center;
  padding: 0 8px;
  gap: 8px;
  z-index: 100;
  padding-top: env(safe-area-inset-top);
}

.tb-btn {
  background: transparent;
  border: none;
  color: var(--text-primary);
  width: 40px;
  height: 40px;
  display: flex;
  align-items: center;
  justify-content: center;
  cursor: pointer;
  border-radius: 4px;
  position: relative;
  flex-shrink: 0;
}

.tb-btn:active {
  background-color: rgba(255, 255, 255, 0.08);
}

.tb-icon {
  width: 22px;
  height: 22px;
  fill: currentColor;
}

.filter-indicator {
  position: absolute;
  top: 8px;
  right: 8px;
  width: 7px;
  height: 7px;
  background-color: var(--nav-active);
  border-radius: 50%;
  display: none;
}

.filter-indicator.active {
  display: block;
}

.search-box {
  flex: 1;
  height: 38px;
  background-color: var(--bg-input);
  border-radius: 4px;
  display: flex;
  align-items: center;
  padding: 0 10px;
  gap: 8px;
  border: 1px solid #444;
}

.search-box:focus-within {
  border-color: var(--nav-active);
}

.search-icon {
  width: 18px;
  height: 18px;
  color: var(--text-secondary);
  flex-shrink: 0;
}

.search-box input {
  flex: 1;
  background: transparent;
  border: none;
  outline: none;
  color: var(--text-primary);
  font-size: 14px;
  width: 100%;
}

.search-box input::placeholder {
  color: var(--text-secondary);
  font-size: 13px;
}

.clear-search-btn {
  background: transparent;
  border: none;
  color: var(--text-secondary);
  font-size: 20px;
  width: 24px;
  height: 24px;
  display: none;
  align-items: center;
  justify-content: center;
  cursor: pointer;
  line-height: 1;
}

.clear-search-btn.visible {
  display: flex;
}

/* SUB-STATUS BAR */
.sub-status-bar {
  position: fixed;
  top: 52px;
  left: 0;
  right: 0;
  height: 28px;
  background-color: #242424;
  border-bottom: 1px solid #333333;
  display: flex;
  align-items: center;
  justify-content: space-between;
  padding: 0 12px;
  font-size: 11px;
  color: var(--text-secondary);
  letter-spacing: 0.3px;
  z-index: 90;
}

.status-left {
  display: flex;
  align-items: center;
  gap: 6px;
  font-weight: 500;
}

.app-brand-badge {
  font-weight: 800;
  letter-spacing: 1.2px;
  color: var(--nav-active);
  font-size: 11px;
}

.status-sep {
  color: #555555;
  font-size: 10px;
}

.pulse-dot {
  width: 6px;
  height: 6px;
  border-radius: 50%;
  background-color: var(--signal-green);
  display: inline-block;
  box-shadow: 0 0 5px var(--signal-green);
}

.pulse-dot.scanning {
  background-color: var(--nav-active);
  box-shadow: 0 0 6px var(--nav-active);
  animation: pulse 1s infinite alternate;
}

@keyframes pulse {
  from { opacity: 0.4; }
  to { opacity: 1; }
}

.scan-btn {
  background: transparent;
  border: 1px solid #444;
  color: var(--text-primary);
  font-size: 11px;
  padding: 2px 8px;
  border-radius: 3px;
  display: flex;
  align-items: center;
  gap: 4px;
  cursor: pointer;
}

.scan-btn:active {
  background-color: #333;
}

.scan-btn .btn-icon {
  width: 12px;
  height: 12px;
}

.scan-btn.spinning .btn-icon {
  animation: spin 0.8s linear infinite;
}

@keyframes spin {
  to { transform: rotate(360deg); }
}

/* MAIN CONTENT */
.main-content {
  position: absolute;
  top: 80px;
  bottom: 56px;
  left: 0;
  right: 0;
  overflow-y: auto;
  overflow-x: hidden;
  -webkit-overflow-scrolling: touch;
  background-color: var(--bg-main);
}

.tab-view {
  display: none;
  min-height: 100%;
}

.tab-view.active {
  display: block;
}

/* TAB 1: DENSE NETWORK LIST (EXACT REFERENCE SPECIFICATION) */
.network-list-container {
  display: flex;
  flex-direction: column;
}

.network-item {
  display: flex;
  flex-direction: column;
  padding: 8px 12px 6px 12px;
  background-color: transparent;
  border-bottom: 1px solid #333333;
  cursor: pointer;
  transition: background-color 0.15s ease;
}

.network-item:active {
  background-color: rgba(255, 255, 255, 0.04);
}

.network-header {
  display: flex;
  align-items: center;
  width: 100%;
  margin-bottom: 6px;
}

/* Left Icon */
.network-icon-col {
  width: 32px;
  display: flex;
  align-items: center;
  justify-content: flex-start;
  flex-shrink: 0;
}

.wifi-icon-stack {
  position: relative;
  width: 24px;
  height: 24px;
  display: flex;
  align-items: center;
  justify-content: center;
}

.wifi-icon {
  width: 20px;
  height: 20px;
  fill: currentColor;
}

.lock-badge {
  position: absolute;
  bottom: -2px;
  right: -2px;
  width: 11px;
  height: 11px;
  background-color: #292929;
  border-radius: 2px;
  display: flex;
  align-items: center;
  justify-content: center;
  color: #c0c0c0;
}

.lock-badge svg {
  width: 9px;
  height: 9px;
  fill: currentColor;
}

/* Middle Text */
.network-info-col {
  flex: 1;
  min-width: 0;
  padding-left: 6px;
  padding-right: 8px;
}

.network-ssid {
  font-size: 14.5px;
  font-weight: 500;
  color: var(--text-primary);
  white-space: nowrap;
  overflow: hidden;
  text-overflow: ellipsis;
  letter-spacing: 0.1px;
}

.network-meta {
  font-size: 11.5px;
  color: var(--text-secondary);
  margin-top: 1px;
  white-space: nowrap;
  overflow: hidden;
  text-overflow: ellipsis;
}

.location-tag-pill {
  display: inline-block;
  font-size: 9.5px;
  background-color: #3a3f4d;
  color: var(--nav-active);
  padding: 0 4px;
  border-radius: 2px;
  margin-left: 5px;
  vertical-align: middle;
}

/* Right RSSI Column */
.network-rssi-col {
  text-align: right;
  flex-shrink: 0;
  display: flex;
  flex-direction: column;
  align-items: flex-end;
  justify-content: center;
}

.rssi-val-row {
  display: flex;
  align-items: center;
  gap: 6px;
}

.current-rssi-val {
  font-size: 14.5px;
  font-weight: 700;
  font-variant-numeric: tabular-nums;
  letter-spacing: -0.2px;
}

.current-rssi-val.good { color: var(--signal-green); }
.current-rssi-val.medium { color: var(--signal-yellow); }
.current-rssi-val.bad { color: var(--signal-red); }

/* Prominent Quality Badges: Green for Good, Yellow for Medium, Red for Bad */
.quality-badge {
  display: inline-flex;
  align-items: center;
  justify-content: center;
  font-size: 10px;
  font-weight: 800;
  letter-spacing: 0.5px;
  padding: 2px 6px;
  border-radius: 4px;
  text-transform: uppercase;
  line-height: 1;
}

.quality-badge.good {
  background-color: var(--signal-green);
  color: #082119;
  box-shadow: 0 0 8px rgba(0, 201, 154, 0.45);
}

.quality-badge.medium {
  background-color: var(--signal-yellow);
  color: #292000;
  box-shadow: 0 0 8px rgba(255, 214, 0, 0.45);
}

.quality-badge.bad {
  background-color: var(--signal-red);
  color: #ffffff;
  box-shadow: 0 0 8px rgba(230, 83, 69, 0.45);
}

.best-rssi-val {
  font-size: 11px;
  color: var(--text-secondary);
  font-variant-numeric: tabular-nums;
  margin-top: 2px;
}

/* Legacy compatibility classes */
.current-rssi {
  font-size: 14px;
  font-weight: 500;
  color: var(--text-primary);
  font-variant-numeric: tabular-nums;
}

.best-rssi {
  font-size: 11px;
  color: var(--text-secondary);
  font-variant-numeric: tabular-nums;
  margin-top: 1px;
}

/* Bottom Signal Bar - Enhanced Precision Track */
.signal-bar-wrap {
  width: 100%;
  padding-top: 5px;
}

.signal-bar-track {
  position: relative;
  width: 100%;
  height: 7px;
  background-color: var(--signal-track);
  border-radius: 3.5px;
  overflow: hidden;
  box-shadow: inset 0 1px 2px rgba(0, 0, 0, 0.5);
}

.signal-bar-fill {
  height: 100%;
  border-radius: 3.5px;
  transition: width 0.35s cubic-bezier(0.4, 0, 0.2, 1);
}

.signal-bar-fill.good {
  background: linear-gradient(90deg, #00A37B 0%, #00C99A 100%);
  box-shadow: 0 0 8px rgba(0, 201, 154, 0.6);
}

.signal-bar-fill.medium {
  background: linear-gradient(90deg, #D49B28 0%, #FFD600 100%);
  box-shadow: 0 0 8px rgba(255, 214, 0, 0.6);
}

.signal-bar-fill.bad {
  background: linear-gradient(90deg, #BA1B1B 0%, #E65345 100%);
  box-shadow: 0 0 8px rgba(230, 83, 69, 0.6);
}

.sig-badge {
  display: inline-block;
  font-size: 10px;
  font-weight: 700;
  padding: 0 4px;
  border-radius: 2px;
  margin-left: 4px;
  vertical-align: baseline;
  text-transform: uppercase;
  letter-spacing: 0.3px;
}

.sig-badge.good {
  background-color: rgba(0, 201, 154, 0.15);
  color: var(--signal-green);
  border: 1px solid rgba(0, 201, 154, 0.35);
}

.sig-badge.medium {
  background-color: rgba(255, 214, 0, 0.15);
  color: var(--signal-yellow);
  border: 1px solid rgba(255, 214, 0, 0.35);
}

.sig-badge.bad {
  background-color: rgba(230, 83, 69, 0.15);
  color: var(--signal-red);
  border: 1px solid rgba(230, 83, 69, 0.35);
}

.current-rssi.good { color: var(--signal-green); }
.current-rssi.medium { color: var(--signal-yellow); }
.current-rssi.bad { color: var(--signal-red); }

/* EMPTY STATE */
.empty-state {
  display: flex;
  flex-direction: column;
  align-items: center;
  justify-content: center;
  padding: 60px 20px;
  color: var(--text-secondary);
  text-align: center;
  gap: 12px;
}

.spinner {
  width: 28px;
  height: 28px;
  border: 3px solid rgba(255, 255, 255, 0.1);
  border-top-color: var(--nav-active);
  border-radius: 50%;
  animation: spin 0.8s linear infinite;
}

/* TAB 2: CHANNELS */
.channels-container {
  padding: 10px 12px 24px 12px;
}

.section-banner {
  display: flex;
  justify-content: space-between;
  align-items: center;
  padding: 6px 0 10px 0;
  border-bottom: 1px solid #383838;
  margin-bottom: 12px;
}

.banner-title {
  font-size: 11px;
  font-weight: 700;
  color: var(--text-secondary);
  letter-spacing: 0.8px;
}

.banner-sub {
  font-size: 11px;
  color: var(--nav-active);
}

.spectrum-graph-card {
  background-color: #20232B;
  border: 1px solid #383838;
  border-radius: 3px;
  padding: 8px 8px 4px 8px;
  margin-bottom: 16px;
}

#spectrum-svg {
  width: 100%;
  height: 180px;
  display: block;
}

.spectrum-x-axis {
  display: flex;
  justify-content: space-between;
  padding: 4px 6px 0 6px;
  font-size: 10px;
  color: var(--text-secondary);
  font-weight: 600;
  border-top: 1px solid #383838;
  margin-top: 4px;
}

.channel-breakdown-title {
  font-size: 11px;
  font-weight: 700;
  color: var(--text-secondary);
  letter-spacing: 0.8px;
  margin: 16px 0 8px 0;
}

.channel-cards-list {
  display: flex;
  flex-direction: column;
  gap: 6px;
}

.channel-row-card {
  background-color: #20232B;
  border: 1px solid #383838;
  border-radius: 3px;
  padding: 8px 10px;
  display: flex;
  align-items: center;
  justify-content: space-between;
}

.ch-badge-col {
  display: flex;
  align-items: center;
  gap: 8px;
}

.ch-number-badge {
  background-color: #292929;
  border: 1px solid #444;
  color: var(--text-primary);
  font-weight: 700;
  font-size: 12px;
  width: 28px;
  height: 28px;
  display: flex;
  align-items: center;
  justify-content: center;
  border-radius: 3px;
}

.ch-number-badge.recommended {
  border-color: var(--signal-green);
  color: var(--signal-green);
}

.ch-info-col {
  flex: 1;
  padding: 0 10px;
}

.ch-networks-names {
  font-size: 12px;
  color: var(--text-primary);
  white-space: nowrap;
  overflow: hidden;
  text-overflow: ellipsis;
  max-width: 200px;
}

.ch-count-meta {
  font-size: 10.5px;
  color: var(--text-secondary);
}

.ch-status-col {
  text-align: right;
  font-size: 11px;
  font-weight: 600;
}

.ch-status-col.low { color: var(--signal-green); }
.ch-status-col.moderate { color: var(--signal-orange); }
.ch-status-col.congested { color: var(--signal-red); }

/* TAB 3: DISCOVERY */
.discovery-container {
  padding: 10px 12px 24px 12px;
}

.discovery-picker-row {
  display: flex;
  flex-direction: column;
  gap: 4px;
  margin-bottom: 12px;
}

.discovery-picker-row label {
  font-size: 11px;
  font-weight: 700;
  color: var(--text-secondary);
  letter-spacing: 0.6px;
}

.discovery-picker-row select {
  background-color: var(--bg-input);
  color: var(--text-primary);
  border: 1px solid #444;
  padding: 8px 10px;
  border-radius: 4px;
  font-size: 13.5px;
  outline: none;
}

.discovery-details-wrap {
  display: flex;
  flex-direction: column;
  gap: 12px;
}

.discovery-card {
  background-color: #20232B;
  border: 1px solid #383838;
  border-radius: 3px;
  padding: 12px;
}

.disc-head {
  display: flex;
  justify-content: space-between;
  align-items: flex-start;
  margin-bottom: 10px;
  border-bottom: 1px solid #333333;
  padding-bottom: 8px;
}

.disc-ssid {
  font-size: 16px;
  font-weight: 600;
  color: var(--text-primary);
  word-break: break-all;
}

.disc-bssid {
  font-size: 11px;
  color: var(--text-secondary);
  font-family: monospace;
  margin-top: 2px;
}

.disc-badge {
  font-size: 10px;
  font-weight: 700;
  padding: 2px 6px;
  border-radius: 2px;
  background-color: #333;
  color: #ddd;
  text-transform: uppercase;
  flex-shrink: 0;
}

.disc-grid {
  display: grid;
  grid-template-columns: 1fr 1fr;
  gap: 8px 12px;
  font-size: 12px;
}

.disc-item {
  display: flex;
  flex-direction: column;
}

.disc-label {
  color: var(--text-secondary);
  font-size: 10.5px;
  text-transform: uppercase;
  letter-spacing: 0.4px;
}

.disc-val {
  color: var(--text-primary);
  font-size: 13px;
  font-weight: 500;
  margin-top: 1px;
}

.disc-val.green { color: var(--signal-green); }
.disc-val.yellow { color: var(--signal-yellow); }
.disc-val.orange { color: var(--signal-yellow); }
.disc-val.red { color: var(--signal-red); }

/* Room Tag Editor */
.tag-input-row {
  display: flex;
  gap: 8px;
  margin-top: 8px;
}

.tag-input-row input {
  flex: 1;
  background-color: #292929;
  border: 1px solid #444;
  color: var(--text-primary);
  padding: 6px 10px;
  border-radius: 3px;
  font-size: 13px;
  outline: none;
}

.tag-input-row button {
  background-color: var(--nav-active);
  color: #000;
  font-weight: 600;
  border: none;
  padding: 6px 14px;
  border-radius: 3px;
  cursor: pointer;
  font-size: 12px;
}

/* History Chart */
.history-sparkline-wrap {
  width: 100%;
  height: 90px;
  margin-top: 8px;
  background-color: #292929;
  border: 1px solid #333;
  border-radius: 2px;
}

.history-sparkline-wrap svg {
  width: 100%;
  height: 100%;
  display: block;
}

/* TAB 4: SPEED TEST & DIAGNOSTICS */
.diagnostics-container {
  padding: 10px 12px 24px 12px;
}

.diag-table {
  background-color: #20232B;
  border: 1px solid #383838;
  border-radius: 3px;
  display: flex;
  flex-direction: column;
}

.diag-row {
  display: flex;
  justify-content: space-between;
  align-items: center;
  padding: 8px 12px;
  border-bottom: 1px solid #2d313b;
  font-size: 12.5px;
}

.diag-row:last-child {
  border-bottom: none;
}

.diag-key {
  color: var(--text-secondary);
}

.diag-val {
  color: var(--text-primary);
  font-weight: 500;
  font-family: monospace;
}

.diag-val.highlight {
  color: var(--nav-active);
  font-weight: 700;
}

.diag-card {
  background-color: #20232B;
  border: 1px solid #383838;
  border-radius: 3px;
  padding: 12px;
  margin-bottom: 10px;
}

.diag-card-header {
  display: flex;
  justify-content: space-between;
  align-items: center;
  margin-bottom: 4px;
}

.diag-card-title {
  font-size: 13px;
  font-weight: 600;
  color: var(--text-primary);
}

.diag-card-stat {
  font-size: 14px;
  font-weight: 700;
  color: var(--nav-active);
  font-family: monospace;
}

.diag-card-desc {
  font-size: 11px;
  color: var(--text-secondary);
  margin-bottom: 10px;
  line-height: 1.4;
}

.action-btn {
  display: inline-flex;
  align-items: center;
  justify-content: center;
  gap: 6px;
  padding: 8px 14px;
  border-radius: 3px;
  font-size: 12px;
  font-weight: 600;
  border: none;
  cursor: pointer;
  text-decoration: none;
  transition: opacity 0.15s ease;
}

.action-btn:active {
  opacity: 0.8;
}

.action-btn.primary {
  background-color: var(--nav-active);
  color: #121419;
}

.action-btn.success {
  background: linear-gradient(135deg, #00A37B, #00C99A);
  color: #121419;
  font-weight: 700;
  box-shadow: 0 2px 8px rgba(0, 201, 154, 0.3);
}

.action-btn.secondary {
  background-color: #2f3440;
  color: var(--text-primary);
  border: 1px solid #444;
}

.action-btn.danger {
  background-color: rgba(230, 83, 69, 0.15);
  color: var(--signal-red);
  border: 1px solid rgba(230, 83, 69, 0.4);
}

.action-btn.full-width {
  width: 100%;
}

.action-btn .btn-icon {
  width: 15px;
  height: 15px;
}

.export-actions-row {
  display: flex;
  flex-direction: column;
  gap: 8px;
  margin-top: 6px;
}

/* FIXED BOTTOM NAVIGATION */
.bottom-nav {
  position: fixed;
  bottom: 0;
  left: 0;
  right: 0;
  height: 56px;
  background-color: var(--bg-nav);
  border-top: 1px solid #2d313b;
  display: flex;
  align-items: center;
  justify-content: space-around;
  z-index: 100;
  padding-bottom: env(safe-area-inset-bottom);
}

.nav-item {
  flex: 1;
  height: 100%;
  background: transparent;
  border: none;
  display: flex;
  flex-direction: column;
  align-items: center;
  justify-content: center;
  gap: 3px;
  color: var(--text-secondary);
  cursor: pointer;
  transition: color 0.15s ease;
}

.nav-item.active {
  color: var(--nav-active);
}

.nav-icon {
  width: 20px;
  height: 20px;
  fill: currentColor;
}

.nav-label {
  font-size: 10.5px;
  font-weight: 500;
  letter-spacing: 0.2px;
}

/* MODAL / OVERLAY */
.modal-overlay {
  position: fixed;
  top: 0;
  left: 0;
  right: 0;
  bottom: 0;
  background-color: rgba(0, 0, 0, 0.65);
  display: none;
  align-items: flex-end;
  justify-content: center;
  z-index: 200;
}

.modal-overlay.open {
  display: flex;
}

.filter-menu {
  background-color: #20232B;
  border-top: 1px solid #383838;
  border-radius: 8px 8px 0 0;
  width: 100%;
  max-width: 480px;
  padding: 16px;
  display: flex;
  flex-direction: column;
  gap: 12px;
  animation: slideUp 0.2s ease-out;
}

@keyframes slideUp {
  from { transform: translateY(100%); }
  to { transform: translateY(0); }
}

.filter-header {
  display: flex;
  justify-content: space-between;
  align-items: center;
  border-bottom: 1px solid #333;
  padding-bottom: 8px;
}

.filter-title {
  font-size: 14px;
  font-weight: 700;
  color: var(--text-primary);
}

.close-modal-btn {
  background: transparent;
  border: none;
  color: var(--text-secondary);
  font-size: 22px;
  cursor: pointer;
  line-height: 1;
}

.filter-section-title {
  font-size: 10px;
  font-weight: 700;
  color: var(--text-secondary);
  letter-spacing: 0.8px;
  margin-top: 4px;
}

.filter-options {
  display: flex;
  flex-direction: column;
  gap: 8px;
}

.filter-option {
  display: flex;
  align-items: center;
  gap: 10px;
  font-size: 13px;
  color: var(--text-primary);
  cursor: pointer;
}

.filter-option input[type="radio"] {
  accent-color: var(--nav-active);
  width: 16px;
  height: 16px;
}

.filter-actions {
  display: flex;
  gap: 10px;
  margin-top: 8px;
}

.filter-actions button {
  flex: 1;
}

/* PWA INSTALL BANNER */
.pwa-install-banner {
  position: fixed;
  bottom: 64px;
  left: 10px;
  right: 10px;
  background-color: #20232B;
  border: 1px solid #383838;
  border-radius: 8px;
  box-shadow: 0 4px 16px rgba(0, 0, 0, 0.7);
  z-index: 150;
  display: none;
  animation: slideUp 0.3s ease;
}

.pwa-install-banner.visible {
  display: block;
}

.pwa-banner-content {
  display: flex;
  align-items: center;
  padding: 10px 12px;
  gap: 10px;
}

.pwa-banner-icon {
  width: 36px;
  height: 36px;
  border-radius: 8px;
  flex-shrink: 0;
}

.pwa-banner-text {
  flex: 1;
  min-width: 0;
}

.pwa-banner-title {
  font-size: 13px;
  font-weight: 700;
  color: var(--text-primary);
  line-height: 1.2;
}

.pwa-banner-sub {
  font-size: 10.5px;
  color: var(--text-secondary);
  line-height: 1.2;
  margin-top: 2px;
  white-space: nowrap;
  overflow: hidden;
  text-overflow: ellipsis;
}

.pwa-install-btn {
  padding: 6px 12px;
  font-size: 12px;
  flex-shrink: 0;
}

.pwa-banner-close {
  background: transparent;
  border: none;
  color: var(--text-secondary);
  font-size: 20px;
  cursor: pointer;
  padding: 2px 4px;
  line-height: 1;
  flex-shrink: 0;
}

/* SUB-STATUS BAR INSTALL APP BUTTON */
.install-pwa-pill-btn {
  background: linear-gradient(135deg, rgba(0, 201, 154, 0.2) 0%, rgba(32, 188, 235, 0.2) 100%);
  border: 1px solid rgba(0, 201, 154, 0.5);
  color: #00C99A;
  font-size: 11px;
  font-weight: 700;
  padding: 2px 8px;
  border-radius: 12px;
  display: inline-flex;
  align-items: center;
  gap: 4px;
  cursor: pointer;
  transition: all 0.2s;
  box-shadow: 0 0 6px rgba(0, 201, 154, 0.25);
}

.install-pwa-pill-btn:active {
  background: rgba(0, 201, 154, 0.4);
  transform: scale(0.96);
}

.btn-icon-pwa {
  width: 12px;
  height: 12px;
  fill: currentColor;
}

/* PWA INSTALL GUIDE MODAL */
.pwa-guide-card {
  background-color: #242630;
  border: 1px solid #3c404f;
  border-radius: 14px;
  width: 90%;
  max-width: 380px;
  padding: 20px;
  box-shadow: 0 10px 30px rgba(0, 0, 0, 0.7);
  animation: slideUp 0.25s ease-out;
}

.pwa-guide-header {
  display: flex;
  align-items: center;
  justify-content: space-between;
  margin-bottom: 14px;
  padding-bottom: 10px;
  border-bottom: 1px solid #333644;
}

.pwa-guide-title {
  display: flex;
  align-items: center;
  gap: 10px;
  font-size: 16px;
  font-weight: 700;
  color: var(--text-primary);
}

.pwa-guide-logo {
  width: 24px;
  height: 24px;
  border-radius: 6px;
}

.pwa-guide-lead {
  font-size: 13px;
  color: var(--text-secondary);
  line-height: 1.45;
  margin-bottom: 14px;
}

.pwa-step-item {
  display: flex;
  align-items: flex-start;
  gap: 10px;
  margin-bottom: 10px;
  background: rgba(255, 255, 255, 0.03);
  padding: 10px;
  border-radius: 8px;
  border: 1px solid #2e313d;
}

.pwa-step-num {
  width: 22px;
  height: 22px;
  border-radius: 50%;
  background: var(--nav-active);
  color: #12141a;
  font-size: 12px;
  font-weight: 800;
  display: flex;
  align-items: center;
  justify-content: center;
  flex-shrink: 0;
}

.pwa-step-text {
  font-size: 13px;
  color: var(--text-primary);
  line-height: 1.4;
}

.pwa-step-text strong {
  color: var(--signal-green);
}

.pwa-guide-footer-note {
  font-size: 11.5px;
  color: #999;
  margin: 12px 0 16px;
  text-align: center;
}

.pwa-guide-actions {
  display: flex;
  gap: 10px;
}

/* TOAST */
.toast {
  position: fixed;
  bottom: 66px;
  left: 50%;
  transform: translateX(-50%) translateY(30px);
  background-color: #1a1a1a;
  color: var(--text-primary);
  border: 1px solid #444;
  padding: 8px 16px;
  border-radius: 20px;
  font-size: 12px;
  box-shadow: 0 4px 12px rgba(0, 0, 0, 0.5);
  pointer-events: none;
  opacity: 0;
  transition: opacity 0.2s ease, transform 0.2s ease;
  z-index: 300;
  white-space: nowrap;
}

.toast.show {
  opacity: 1;
  transform: translateX(-50%) translateY(0);
}
)rawliteral";

const char APP_JS[] PROGMEM = R"rawliteral(/**
 * WΛVΞSCAN — Mobile Wi-Fi Analyzer Frontend
 * Vanilla JavaScript (ES6+), Zero external frameworks, Android Chrome Optimized
 */

(function () {
  'use strict';

  // --- STATE ---
  const state = {
    networks: [],
    historyLog: {}, // bssid -> array of { rssi, timestamp }
    bestRSSI: {},   // bssid -> highest rssi number
    roomTags: {},   // bssid -> string label
    activeTab: 'tab-list',
    selectedBSSID: null,
    searchQuery: '',
    filterType: 'all',    // all, secured, open, strong, weak
    sortType: 'rssi',     // rssi, ssid, channel
    isScanning: false,
    espStatus: {},
    autoScanTimer: null
  };

  // --- LOCAL STORAGE KEYS ---
  const STORAGE_BEST_RSSI = 'wavescan_best_rssi';
  const STORAGE_ROOM_TAGS = 'wavescan_room_tags';

  // --- DOM ELEMENTS ---
  const el = {
    // Toolbar
    btnBack: document.getElementById('btn-back'),
    searchInput: document.getElementById('search-input'),
    btnClearSearch: document.getElementById('btn-clear-search'),
    btnFilter: document.getElementById('btn-filter'),
    filterIndicator: document.getElementById('filter-indicator'),
    filterModal: document.getElementById('filter-modal'),
    btnCloseFilter: document.getElementById('btn-close-filter'),
    btnResetFilter: document.getElementById('btn-reset-filter'),
    btnApplyFilter: document.getElementById('btn-apply-filter'),

    // Sub Status Bar
    liveDot: document.getElementById('live-dot'),
    networkCountText: document.getElementById('network-count-text'),
    btnScanNow: document.getElementById('btn-scan-now'),
    scanBtnLabel: document.getElementById('scan-btn-label'),

    // Tabs
    tabViews: document.querySelectorAll('.tab-view'),
    navItems: document.querySelectorAll('.nav-item'),

    // Tab 1: List
    networkList: document.getElementById('network-list'),

    // Tab 2: Channels
    spectrumSvg: document.getElementById('spectrum-svg'),
    chActiveSummary: document.getElementById('ch-active-summary'),
    channelBreakdownList: document.getElementById('channel-breakdown-list'),

    // Tab 3: Discovery
    discoverySelect: document.getElementById('discovery-select'),
    discoveryDetails: document.getElementById('discovery-details'),

    // Tab 4: Diagnostics
    diagUptime: document.getElementById('diag-uptime'),
    diagMode: document.getElementById('diag-mode'),
    diagSsid: document.getElementById('diag-ssid'),
    diagIp: document.getElementById('diag-ip'),
    diagMac: document.getElementById('diag-mac'),
    diagHeap: document.getElementById('diag-heap'),
    diagDuration: document.getElementById('diag-duration'),
    diagTotalAp: document.getElementById('diag-total-ap'),
    pingResult: document.getElementById('ping-result'),
    btnRunPing: document.getElementById('btn-run-ping'),
    throughputResult: document.getElementById('throughput-result'),
    btnRunThroughput: document.getElementById('btn-run-throughput'),
    btnClearLocalStorage: document.getElementById('btn-clear-localstorage'),

    // Toast
    toast: document.getElementById('toast')
  };

  // --- UTILITIES ---

  function clamp(val, min, max) {
    return Math.max(min, Math.min(max, val));
  }

  // Exact prompt formula: percentage = clamp((RSSI + 100) * 2, 0, 100)
  function rssiToPercentage(rssi) {
    if (typeof rssi !== 'number' || isNaN(rssi)) return 0;
    return clamp(Math.round((rssi + 100) * 2), 0, 100);
  }

  // Signal assessment logic:
  // Green for Good: >= -65 dBm
  // Yellow for Medium: -66 to -75 dBm
  // Red for Bad: < -75 dBm
  function getSignalInfo(rssi) {
    const val = Number(rssi);
    if (isNaN(val)) {
      return { color: '#E65345', class: 'bad', label: 'Bad' };
    }
    if (val >= -65) {
      return { color: '#00C99A', class: 'good', label: 'Good' };
    }
    if (val >= -75) {
      return { color: '#FFD600', class: 'medium', label: 'Medium' };
    }
    return { color: '#E65345', class: 'bad', label: 'Bad' };
  }

  function getSignalColor(rssi) {
    return getSignalInfo(rssi).color;
  }

  function getSignalQualityLabel(rssi) {
    return getSignalInfo(rssi).label;
  }

  // Channel center frequency in MHz (2.4 GHz band)
  function channelToFrequency(ch) {
    if (ch >= 1 && ch <= 13) return 2412 + (ch - 1) * 5;
    if (ch === 14) return 2484;
    return 2412;
  }

  // Approximate free space path loss distance estimate
  function estimateDistance(rssi, freqMHz) {
    if (!rssi) return 'N/A';
    const f = freqMHz || 2437;
    // Friis formula: distance = 10 ^ ((27.55 - (20 * log10(f)) + abs(rssi)) / 20)
    const exp = (27.55 - (20 * Math.log10(f)) + Math.abs(rssi)) / 20.0;
    const dist = Math.pow(10, exp);
    if (dist < 1) return '< 1 m';
    if (dist > 150) return '> 150 m';
    return `${dist.toFixed(1)} m`;
  }

  function showToast(message, duration = 2500) {
    if (!el.toast) return;
    el.toast.textContent = message;
    el.toast.classList.add('show');
    clearTimeout(el.toast._timer);
    el.toast._timer = setTimeout(() => {
      el.toast.classList.remove('show');
    }, duration);
  }

  // --- LOCAL STORAGE MANAGEMENT ---

  function loadSavedStorage() {
    try {
      const best = localStorage.getItem(STORAGE_BEST_RSSI);
      if (best) state.bestRSSI = JSON.parse(best);
    } catch (e) {
      console.warn('Failed to parse saved best RSSI:', e);
      state.bestRSSI = {};
    }

    try {
      const tags = localStorage.getItem(STORAGE_ROOM_TAGS);
      if (tags) state.roomTags = JSON.parse(tags);
    } catch (e) {
      console.warn('Failed to parse saved room tags:', e);
      state.roomTags = {};
    }
  }

  function saveBestRSSI() {
    try {
      localStorage.setItem(STORAGE_BEST_RSSI, JSON.stringify(state.bestRSSI));
    } catch (e) {
      console.warn('Failed to save best RSSI:', e);
    }
  }

  function saveRoomTags() {
    try {
      localStorage.setItem(STORAGE_ROOM_TAGS, JSON.stringify(state.roomTags));
    } catch (e) {
      console.warn('Failed to save room tags:', e);
    }
  }

  // Update best RSSI records for all received networks
  function updateBestRSSIRecords(networks) {
    let hasChanges = false;
    const now = Date.now();

    networks.forEach(net => {
      if (!net.bssid) return;
      const bssid = net.bssid.toUpperCase();
      const current = net.rssi;

      // Initialize or update best RSSI (algebraically greater: -50 > -70)
      if (state.bestRSSI[bssid] === undefined || current > state.bestRSSI[bssid]) {
        state.bestRSSI[bssid] = current;
        hasChanges = true;
      }

      // Record in-session history sparkline log
      if (!state.historyLog[bssid]) {
        state.historyLog[bssid] = [];
      }
      state.historyLog[bssid].push({ rssi: current, time: now });
      if (state.historyLog[bssid].length > 30) {
        state.historyLog[bssid].shift();
      }
    });

    if (hasChanges) {
      saveBestRSSI();
    }
  }

  // --- SVG ICONS GENERATOR ---

  function getWifiSvgIcon(rssi) {
    const color = getSignalColor(rssi);
    // 4 curved bars: dot, inner, mid, outer
    const pct = rssiToPercentage(rssi);
    const op1 = pct > 15 ? 1 : 0.25;
    const op2 = pct > 40 ? 1 : 0.25;
    const op3 = pct > 70 ? 1 : 0.25;

    return `
      <svg class="wifi-icon" viewBox="0 0 24 24" style="color: ${color};">
        <path d="M12 18.5c-.83 0-1.5.67-1.5 1.5s.67 1.5 1.5 1.5 1.5-.67 1.5-1.5-.67-1.5-1.5-1.5z" fill="currentColor"/>
        <path d="M12 14c-2.3 0-4.38.93-5.9 2.44l1.42 1.42C8.67 16.71 10.24 16 12 16s3.33.71 4.48 1.86l1.42-1.42C16.38 14.93 14.3 14 12 14z" fill="currentColor" opacity="${op1}"/>
        <path d="M12 9.5c-3.53 0-6.73 1.43-9.05 3.75l1.42 1.42C6.31 12.73 9 11.5 12 11.5s5.69 1.23 7.63 3.17l1.42-1.42C18.73 10.93 15.53 9.5 12 9.5z" fill="currentColor" opacity="${op2}"/>
        <path d="M12 5C7.27 5 2.99 6.91-.01 10.02l1.42 1.42C3.84 8.79 7.69 7 12 7s8.16 1.79 10.59 4.44l1.42-1.42C21.01 6.91 16.73 5 12 5z" fill="currentColor" opacity="${op3}"/>
      </svg>
    `;
  }

  function getLockSvgIcon() {
    return `
      <svg viewBox="0 0 24 24">
        <path d="M18 8h-1V6c0-2.76-2.24-5-5-5S7 3.24 7 6v2H6c-1.1 0-2 .9-2 2v10c0 1.1.9 2 2 2h12c1.1 0 2-.9 2-2V10c0-1.1-.9-2-2-2zm-6 9c-1.1 0-2-.9-2-2s.9-2 2-2 2 .9 2 2-.9 2-2 2zm3.1-9H8.9V6c0-1.71 1.39-3.1 3.1-3.1 1.71 0 3.1 1.39 3.1 3.1v2z"/>
      </svg>
    `;
  }

  // --- RENDERING: TAB 1 (LIST VIEW) ---

  function renderNetworkList() {
    if (!el.networkList) return;

    let list = [...state.networks];

    // 1. Search Query Filter
    if (state.searchQuery.trim() !== '') {
      const q = state.searchQuery.toLowerCase();
      list = list.filter(net => {
        const ssid = (net.ssid || '').toLowerCase();
        const bssid = (net.bssid || '').toLowerCase();
        const tag = (state.roomTags[net.bssid?.toUpperCase()] || '').toLowerCase();
        return ssid.includes(q) || bssid.includes(q) || tag.includes(q);
      });
    }

    // 2. Type Filter
    if (state.filterType === 'secured') {
      list = list.filter(net => net.isSecured || (net.encryption && net.encryption !== 'OPEN'));
    } else if (state.filterType === 'open') {
      list = list.filter(net => !net.isSecured && (!net.encryption || net.encryption === 'OPEN'));
    } else if (state.filterType === 'strong') {
      list = list.filter(net => net.rssi >= -65);
    } else if (state.filterType === 'weak') {
      list = list.filter(net => net.rssi < -75);
    }

    // 3. Sorting
    if (state.sortType === 'rssi') {
      list.sort((a, b) => b.rssi - a.rssi); // Strongest first (-45 before -75)
    } else if (state.sortType === 'ssid') {
      list.sort((a, b) => (a.ssid || '').localeCompare(b.ssid || ''));
    } else if (state.sortType === 'channel') {
      list.sort((a, b) => (a.channel || 0) - (b.channel || 0));
    }

    // Update Status Bar Count
    el.networkCountText.textContent = `${list.length} of ${state.networks.length} networks · 2.4 GHz`;

    if (list.length === 0) {
      if (state.networks.length === 0) {
        el.networkList.innerHTML = `
          <div class="empty-state">
            <div class="spinner"></div>
            <p>Scanning 2.4 GHz Wi-Fi spectrum...</p>
          </div>
        `;
      } else {
        el.networkList.innerHTML = `
          <div class="empty-state">
            <p>No networks match the current filter or search criteria.</p>
          </div>
        `;
      }
      return;
    }

    // Build Dense Network Rows HTML
    let html = '';
    for (const net of list) {
      const bssidUpper = (net.bssid || '').toUpperCase();
      const currentRSSI = net.rssi;
      const bestRSSI = state.bestRSSI[bssidUpper] !== undefined ? state.bestRSSI[bssidUpper] : currentRSSI;
      const currentPct = rssiToPercentage(currentRSSI);
      const sigInfo = getSignalInfo(currentRSSI);
      const isSecured = net.isSecured || (net.encryption && net.encryption !== 'OPEN');
      const securityLabel = net.encryption || (isSecured ? 'WPA2' : 'OPEN');
      const roomTag = state.roomTags[bssidUpper];
      const tagHtml = roomTag ? `<span class="location-tag-pill">${escapeHtml(roomTag)}</span>` : '';

      html += `
        <div class="network-item" data-bssid="${escapeHtml(bssidUpper)}">
          <div class="network-header">
            <div class="network-icon-col">
              <div class="wifi-icon-stack">
                ${getWifiSvgIcon(currentRSSI)}
                ${isSecured ? `<span class="lock-badge">${getLockSvgIcon()}</span>` : ''}
              </div>
            </div>

            <div class="network-info-col">
              <div class="network-ssid">${escapeHtml(net.ssid || '[Hidden SSID]')}${tagHtml}</div>
              <div class="network-meta">Channel ${net.channel || '?'} · ${escapeHtml(securityLabel)}</div>
            </div>

            <div class="network-rssi-col">
              <div class="rssi-val-row">
                <span class="current-rssi-val ${sigInfo.class}">${currentRSSI} dBm</span>
                <span class="quality-badge ${sigInfo.class}">${sigInfo.label.toUpperCase()}</span>
              </div>
              <div class="best-rssi-val">${bestRSSI} dBm Best</div>
            </div>
          </div>

          <div class="signal-bar-wrap">
            <div class="signal-bar-track">
              <div class="signal-bar-fill ${sigInfo.class}" style="width: ${currentPct}%;"></div>
            </div>
          </div>
        </div>
      `;
    }

    el.networkList.innerHTML = html;

    // Attach click handlers to rows to open Discovery Tab
    const rows = el.networkList.querySelectorAll('.network-item');
    rows.forEach(row => {
      row.addEventListener('click', () => {
        const bssid = row.getAttribute('data-bssid');
        if (bssid) {
          selectNetworkForDiscovery(bssid);
          switchTab('tab-discovery');
        }
      });
    });
  }

  // --- RENDERING: TAB 2 (CHANNELS SPECTRUM) ---

  function renderChannelsView() {
    if (!el.spectrumSvg || !el.channelBreakdownList) return;

    // Group networks by channel (1 to 14)
    const channelMap = {};
    for (let c = 1; c <= 14; c++) {
      channelMap[c] = [];
    }

    state.networks.forEach(net => {
      const ch = parseInt(net.channel, 10);
      if (ch >= 1 && ch <= 14) {
        channelMap[ch].push(net);
      }
    });

    let activeChannelsCount = 0;
    for (let c = 1; c <= 14; c++) {
      if (channelMap[c].length > 0) activeChannelsCount++;
    }
    el.chActiveSummary.textContent = `${activeChannelsCount} Active Channels detected`;

    // Render SVG Spectrum Parabolic Waves
    // SVG viewBox: 0 0 380 200
    // X channels: 1 to 14 mapped across X = 15 to 365
    // Y dBm: -100 (Y=185) to -40 (Y=20)
    const startX = 20;
    const endX = 360;
    const chStep = (endX - startX) / 13; // 14 channels = 13 intervals

    function chToX(ch) {
      return startX + (ch - 1) * chStep;
    }

    function rssiToY(rssi) {
      // -100 dBm -> Y=185, -40 dBm -> Y=25
      const clamped = clamp(rssi, -100, -40);
      const ratio = (clamped - (-100)) / 60.0; // 0.0 at -100, 1.0 at -40
      return 185 - (ratio * 160);
    }

    let svgHtml = `
      <defs>
        <linearGradient id="curveGrad" x1="0%" y1="0%" x2="0%" y2="100%">
          <stop offset="0%" stop-color="#20BCEB" stop-opacity="0.3"/>
          <stop offset="100%" stop-color="#20BCEB" stop-opacity="0.0"/>
        </linearGradient>
      </defs>

      <!-- Background Grid lines -->
      <line x1="15" y1="25" x2="365" y2="25" stroke="#333" stroke-dasharray="2,2" stroke-width="0.8"/>
      <line x1="15" y1="65" x2="365" y2="65" stroke="#333" stroke-dasharray="2,2" stroke-width="0.8"/>
      <line x1="15" y1="105" x2="365" y2="105" stroke="#333" stroke-dasharray="2,2" stroke-width="0.8"/>
      <line x1="15" y1="145" x2="365" y2="145" stroke="#333" stroke-dasharray="2,2" stroke-width="0.8"/>
      <line x1="15" y1="185" x2="365" y2="185" stroke="#444" stroke-width="1.2"/>

      <!-- Y Axis dBm labels -->
      <text x="2" y="28" fill="#666" font-size="8">-40</text>
      <text x="2" y="68" fill="#666" font-size="8">-55</text>
      <text x="2" y="108" fill="#666" font-size="8">-70</text>
      <text x="2" y="148" fill="#666" font-size="8">-85</text>
      <text x="0" y="188" fill="#666" font-size="8">-100</text>
    `;

    // Render channels vertical guide markers for standard channels 1, 6, 11
    [1, 6, 11].forEach(stdCh => {
      const cx = chToX(stdCh);
      svgHtml += `<line x1="${cx}" y1="15" x2="${cx}" y2="185" stroke="#3d4454" stroke-width="0.8" stroke-dasharray="3,3"/>`;
    });

    // Draw Parabolic curves for each detected network
    // A 2.4 GHz 20 MHz Wi-Fi signal spans approx +- 2 channels width
    const halfWidthX = chStep * 2;

    state.networks.forEach((net, index) => {
      const ch = parseInt(net.channel, 10);
      if (ch < 1 || ch > 14) return;

      const centerX = chToX(ch);
      const peakY = rssiToY(net.rssi);
      const baseY = 185;
      const leftX = Math.max(15, centerX - halfWidthX);
      const rightX = Math.min(365, centerX + halfWidthX);
      const strokeColor = getSignalColor(net.rssi);

      // SVG quadratic curve
      const pathD = `M ${leftX} ${baseY} Q ${centerX} ${peakY} ${rightX} ${baseY}`;
      svgHtml += `
        <path d="${pathD}" fill="none" stroke="${strokeColor}" stroke-width="1.8" opacity="0.85" />
      `;

      // Label at peak (truncate SSID)
      const cleanSSID = (net.ssid || 'AP').substring(0, 8);
      svgHtml += `
        <text x="${centerX}" y="${peakY - 4}" fill="${strokeColor}" font-size="8" font-weight="600" text-anchor="middle">
          ${escapeHtml(cleanSSID)}
        </text>
      `;
    });

    el.spectrumSvg.innerHTML = svgHtml;

    // Render Channel Breakdown Cards List
    let listHtml = '';
    for (let c = 1; c <= 14; c++) {
      const nets = channelMap[c];
      const count = nets.length;
      if (count === 0) continue;

      const isStd = (c === 1 || c === 6 || c === 11);
      let statusClass = 'low';
      let statusText = 'Clean';
      if (count >= 5) {
        statusClass = 'congested';
        statusText = 'Congested';
      } else if (count >= 3) {
        statusClass = 'moderate';
        statusText = 'Moderate';
      }

      const names = nets.map(n => `${escapeHtml(n.ssid || '[Hidden]')} (${n.rssi} dBm)`).join(', ');

      listHtml += `
        <div class="channel-row-card">
          <div class="ch-badge-col">
            <div class="ch-number-badge ${isStd ? 'recommended' : ''}">
              ${c}
            </div>
          </div>
          <div class="ch-info-col">
            <div class="ch-networks-names" title="${names}">${names}</div>
            <div class="ch-count-meta">${count} AP${count > 1 ? 's' : ''} · ${channelToFrequency(c)} MHz ${isStd ? '· Primary Non-Overlapping' : ''}</div>
          </div>
          <div class="ch-status-col ${statusClass}">
            ${statusText}
          </div>
        </div>
      `;
    }

    if (listHtml === '') {
      listHtml = '<div class="empty-state"><p>No active 2.4 GHz channels detected yet.</p></div>';
    }

    el.channelBreakdownList.innerHTML = listHtml;
  }

  // --- RENDERING: TAB 3 (DISCOVERY VIEW) ---

  function selectNetworkForDiscovery(bssid) {
    state.selectedBSSID = bssid ? bssid.toUpperCase() : null;
    renderDiscoveryView();
  }

  function renderDiscoveryView() {
    if (!el.discoverySelect || !el.discoveryDetails) return;

    // Populate Selector Dropdown
    let optionsHtml = '<option value="">-- Choose a network to inspect --</option>';
    state.networks.forEach(net => {
      const bUpper = (net.bssid || '').toUpperCase();
      const selected = bUpper === state.selectedBSSID ? 'selected' : '';
      const tag = state.roomTags[bUpper] ? ` [${state.roomTags[bUpper]}]` : '';
      optionsHtml += `<option value="${escapeHtml(bUpper)}" ${selected}>${escapeHtml(net.ssid || '[Hidden]')} (${net.rssi} dBm)${escapeHtml(tag)}</option>`;
    });
    el.discoverySelect.innerHTML = optionsHtml;

    if (!state.selectedBSSID) {
      el.discoveryDetails.innerHTML = `
        <div class="no-selection-msg">
          <p>Select a network from the List tab or choose from the dropdown above to view deep diagnostic details, signal telemetry, and assign location tags.</p>
        </div>
      `;
      return;
    }

    const net = state.networks.find(n => (n.bssid || '').toUpperCase() === state.selectedBSSID);
    if (!net) {
      el.discoveryDetails.innerHTML = `
        <div class="no-selection-msg">
          <p>The selected network (${state.selectedBSSID}) was not detected in the latest scan.</p>
        </div>
      `;
      return;
    }

    const bssidUpper = state.selectedBSSID;
    const currentRSSI = net.rssi;
    const bestRSSI = state.bestRSSI[bssidUpper] !== undefined ? state.bestRSSI[bssidUpper] : currentRSSI;
    const freq = channelToFrequency(net.channel);
    const dist = estimateDistance(currentRSSI, freq);
    const quality = getSignalQualityLabel(currentRSSI);
    const pct = rssiToPercentage(currentRSSI);
    const isSecured = net.isSecured || (net.encryption && net.encryption !== 'OPEN');
    const secType = net.encryption || (isSecured ? 'WPA2-PSK' : 'OPEN');
    const roomTag = state.roomTags[bssidUpper] || '';
    const sigInfo = getSignalInfo(currentRSSI);
    const colorClass = sigInfo.class === 'good' ? 'green' : (sigInfo.class === 'medium' ? 'yellow' : 'red');

    // Build Sparkline for recent readings
    const history = state.historyLog[bssidUpper] || [{ rssi: currentRSSI, time: Date.now() }];
    let sparklineSvg = '';
    if (history.length > 1) {
      const w = 340;
      const h = 75;
      const pts = history.map((item, idx) => {
        const x = (idx / (history.length - 1)) * (w - 20) + 10;
        const clamped = clamp(item.rssi, -100, -40);
        const y = h - 10 - ((clamped - (-100)) / 60.0) * (h - 20);
        return `${x.toFixed(1)},${y.toFixed(1)}`;
      }).join(' ');

      sparklineSvg = `
        <svg viewBox="0 0 340 75" preserveAspectRatio="none">
          <polyline fill="none" stroke="${getSignalColor(currentRSSI)}" stroke-width="2" points="${pts}"/>
          ${history.map((item, idx) => {
            const x = (idx / (history.length - 1)) * (w - 20) + 10;
            const clamped = clamp(item.rssi, -100, -40);
            const y = h - 10 - ((clamped - (-100)) / 60.0) * (h - 20);
            return `<circle cx="${x.toFixed(1)}" cy="${y.toFixed(1)}" r="2.5" fill="#EEEEEE"/>`;
          }).join('')}
        </svg>
      `;
    } else {
      sparklineSvg = '<div style="padding: 24px; text-align: center; color: #777; font-size: 11px;">Gathering historical telemetry points...</div>';
    }

    el.discoveryDetails.innerHTML = `
      <div class="discovery-card">
        <div class="disc-head">
          <div>
            <div class="disc-ssid">${escapeHtml(net.ssid || '[Hidden Network]')}</div>
            <div class="disc-bssid">${escapeHtml(bssidUpper)}</div>
          </div>
          <div class="disc-badge">${escapeHtml(secType)}</div>
        </div>

        <div class="disc-grid">
          <div class="disc-item">
            <span class="disc-label">Current Signal</span>
            <span class="disc-val ${colorClass}">${currentRSSI} dBm (${pct}%)</span>
          </div>
          <div class="disc-item">
            <span class="disc-label">Historical Best</span>
            <span class="disc-val">${bestRSSI} dBm</span>
          </div>
          <div class="disc-item">
            <span class="disc-label">Quality Rating</span>
            <span class="disc-val">${quality}</span>
          </div>
          <div class="disc-item">
            <span class="disc-label">Estimated Distance</span>
            <span class="disc-val">${dist}</span>
          </div>
          <div class="disc-item">
            <span class="disc-label">Channel & Freq</span>
            <span class="disc-val">CH ${net.channel || '?'} (${freq} MHz)</span>
          </div>
          <div class="disc-item">
            <span class="disc-label">Security Protocol</span>
            <span class="disc-val">${escapeHtml(secType)}</span>
          </div>
        </div>
      </div>

      <!-- Location Tagging -->
      <div class="discovery-card">
        <div class="disc-label">ROOM / SURVEY LOCATION LABEL</div>
        <p style="font-size: 11px; color: var(--text-secondary); margin-top: 4px;">
          Assign a persistent custom location tag (e.g. Bedroom, Hallway, Office) stored locally in browser storage.
        </p>
        <div class="tag-input-row">
          <input type="text" id="input-room-tag" placeholder="e.g. Living Room, Desk" value="${escapeHtml(roomTag)}" maxlength="30">
          <button id="btn-save-tag">Save Tag</button>
        </div>
      </div>

      <!-- Historical Signal Sparkline -->
      <div class="discovery-card">
        <div class="disc-label">REAL-TIME SIGNAL TELEMETRY TREND (${history.length} SAMPLES)</div>
        <div class="history-sparkline-wrap">
          ${sparklineSvg}
        </div>
      </div>
    `;

    // Hook Room Tag Save
    const btnSaveTag = document.getElementById('btn-save-tag');
    const inputRoomTag = document.getElementById('input-room-tag');
    if (btnSaveTag && inputRoomTag) {
      btnSaveTag.addEventListener('click', () => {
        const tag = inputRoomTag.value.trim();
        if (tag) {
          state.roomTags[bssidUpper] = tag;
          showToast(`Location tagged as "${tag}"`);
        } else {
          delete state.roomTags[bssidUpper];
          showToast('Location tag cleared');
        }
        saveRoomTags();
        renderNetworkList();
        renderDiscoveryView();
      });
    }
  }

  // --- RENDERING: TAB 4 (SPEED TEST & DIAGNOSTICS) ---

  function renderDiagnosticsView() {
    const s = state.espStatus || {};
    if (el.diagUptime) el.diagUptime.textContent = `Uptime: ${formatUptime(s.uptimeSeconds || 0)}`;
    if (el.diagMode) el.diagMode.textContent = s.mode || 'ESP32 Station (STA)';
    if (el.diagSsid) el.diagSsid.textContent = s.connectedSSID || '--';
    if (el.diagIp) el.diagIp.textContent = s.ip || window.location.hostname || '--';
    if (el.diagMac) el.diagMac.textContent = s.mac || '--';
    if (el.diagHeap) el.diagHeap.textContent = s.freeHeap ? `${Math.round(s.freeHeap / 1024)} KB` : '-- KB';
    if (el.diagDuration) el.diagDuration.textContent = s.lastScanDuration ? `${s.lastScanDuration} ms` : '-- ms';
    if (el.diagTotalAp) el.diagTotalAp.textContent = s.detectedCount !== undefined ? s.detectedCount : state.networks.length;
  }

  function formatUptime(seconds) {
    if (!seconds || isNaN(seconds)) return '00:00:00';
    const hrs = Math.floor(seconds / 3600);
    const mins = Math.floor((seconds % 3600) / 60);
    const secs = seconds % 60;
    return `${String(hrs).padStart(2, '0')}:${String(mins).padStart(2, '0')}:${String(secs).padStart(2, '0')}`;
  }

  // --- BENCHMARKS (PING & THROUGHPUT) ---

  async function runPingTest() {
    if (el.btnRunPing) el.btnRunPing.disabled = true;
    el.pingResult.textContent = 'Testing...';

    const pings = [];
    try {
      for (let i = 0; i < 4; i++) {
        const start = performance.now();
        const res = await fetch(`/api/ping?t=${Date.now()}`, { cache: 'no-store' });
        if (res.ok) {
          const latency = Math.round(performance.now() - start);
          pings.push(latency);
        }
        await new Promise(r => setTimeout(r, 100));
      }

      if (pings.length > 0) {
        const avg = Math.round(pings.reduce((a, b) => a + b, 0) / pings.length);
        const min = Math.min(...pings);
        const max = Math.max(...pings);
        el.pingResult.textContent = `${avg} ms (min ${min} / max ${max})`;
      } else {
        el.pingResult.textContent = 'Error';
      }
    } catch (err) {
      console.error('Ping test error:', err);
      el.pingResult.textContent = 'Failed';
    } finally {
      if (el.btnRunPing) el.btnRunPing.disabled = false;
    }
  }

  async function runThroughputTest() {
    if (el.btnRunThroughput) el.btnRunThroughput.disabled = true;
    el.throughputResult.textContent = 'Transferring...';

    try {
      const startTime = performance.now();
      const res = await fetch(`/api/speedtest?t=${Date.now()}`, { cache: 'no-store' });
      if (!res.ok) throw new Error(`HTTP ${res.status}`);

      const blob = await res.blob();
      const durationSec = (performance.now() - startTime) / 1000.0;
      const bytes = blob.size;

      // Calculate speed in Megabits per second
      const bits = bytes * 8;
      const mbps = (bits / (durationSec * 1000000.0)).toFixed(2);
      el.throughputResult.textContent = `${mbps} Mbps (${Math.round(bytes / 1024)} KB in ${durationSec.toFixed(2)}s)`;
    } catch (err) {
      console.error('Throughput test error:', err);
      el.throughputResult.textContent = 'Unavailable';
    } finally {
      if (el.btnRunThroughput) el.btnRunThroughput.disabled = false;
    }
  }

  // --- DATA FETCHING & ASYNC SCANNING ---

  async function fetchScanResults() {
    try {
      const res = await fetch('/api/results', { cache: 'no-store' });
      if (!res.ok) throw new Error(`HTTP ${res.status}`);
      const data = await res.json();

      if (Array.isArray(data)) {
        state.networks = data;
        updateBestRSSIRecords(state.networks);
        renderCurrentTab();
      }
    } catch (err) {
      console.warn('Could not fetch scan results:', err);
    }
  }

  async function fetchStatus() {
    try {
      const res = await fetch('/api/status', { cache: 'no-store' });
      if (!res.ok) throw new Error(`HTTP ${res.status}`);
      const data = await res.json();
      state.espStatus = data;

      // Update Live Indicator
      if (data.scanning) {
        state.isScanning = true;
        el.liveDot.classList.add('scanning');
        el.btnScanNow.classList.add('spinning');
        el.scanBtnLabel.textContent = 'Scanning';
      } else {
        const wasScanning = state.isScanning;
        state.isScanning = false;
        el.liveDot.classList.remove('scanning');
        el.btnScanNow.classList.remove('spinning');
        el.scanBtnLabel.textContent = 'Scan';

        // If a scan just finished, fetch fresh results
        if (wasScanning) {
          await fetchScanResults();
        }
      }

      if (state.activeTab === 'tab-diagnostics') {
        renderDiagnosticsView();
      }
    } catch (err) {
      console.warn('Status poll warning:', err);
    }
  }

  async function triggerScan() {
    if (state.isScanning) return;
    try {
      el.btnScanNow.classList.add('spinning');
      el.scanBtnLabel.textContent = 'Scanning';
      state.isScanning = true;
      el.liveDot.classList.add('scanning');

      const res = await fetch('/api/scan', { method: 'POST' });
      if (!res.ok) throw new Error(`HTTP ${res.status}`);

      showToast('Wi-Fi scan initiated');
      // Trigger status check shortly
      setTimeout(fetchStatus, 1000);
    } catch (err) {
      console.error('Failed to trigger scan:', err);
      showToast('Scan request error');
      state.isScanning = false;
      el.liveDot.classList.remove('scanning');
      el.btnScanNow.classList.remove('spinning');
      el.scanBtnLabel.textContent = 'Scan';
    }
  }

  // --- TAB SWITCHING ---

  function switchTab(tabId) {
    state.activeTab = tabId;

    el.tabViews.forEach(v => {
      if (v.id === tabId) {
        v.classList.add('active');
      } else {
        v.classList.remove('active');
      }
    });

    el.navItems.forEach(item => {
      if (item.getAttribute('data-tab') === tabId) {
        item.classList.add('active');
      } else {
        item.classList.remove('active');
      }
    });

    renderCurrentTab();
  }

  function renderCurrentTab() {
    if (state.activeTab === 'tab-list') {
      renderNetworkList();
    } else if (state.activeTab === 'tab-channels') {
      renderChannelsView();
    } else if (state.activeTab === 'tab-discovery') {
      renderDiscoveryView();
    } else if (state.activeTab === 'tab-diagnostics') {
      renderDiagnosticsView();
    }
  }

  // --- EVENT LISTENERS ---

  function initEventListeners() {
    // Bottom Nav Tabs
    el.navItems.forEach(item => {
      item.addEventListener('click', () => {
        const tab = item.getAttribute('data-tab');
        if (tab) switchTab(tab);
      });
    });

    // Back Arrow Button
    el.btnBack.addEventListener('click', () => {
      if (state.activeTab !== 'tab-list') {
        switchTab('tab-list');
      } else if (state.searchQuery !== '') {
        state.searchQuery = '';
        el.searchInput.value = '';
        el.btnClearSearch.classList.remove('visible');
        renderNetworkList();
      } else {
        triggerScan();
      }
    });

    // Search Input
    el.searchInput.addEventListener('input', (e) => {
      state.searchQuery = e.target.value;
      if (state.searchQuery.length > 0) {
        el.btnClearSearch.classList.add('visible');
      } else {
        el.btnClearSearch.classList.remove('visible');
      }
      renderNetworkList();
    });

    // Clear Search Button
    el.btnClearSearch.addEventListener('click', () => {
      state.searchQuery = '';
      el.searchInput.value = '';
      el.btnClearSearch.classList.remove('visible');
      renderNetworkList();
      el.searchInput.focus();
    });

    // Filter Button & Modal
    el.btnFilter.addEventListener('click', () => {
      el.filterModal.classList.add('open');
    });

    el.btnCloseFilter.addEventListener('click', () => {
      el.filterModal.classList.remove('open');
    });

    el.filterModal.addEventListener('click', (e) => {
      if (e.target === el.filterModal) {
        el.filterModal.classList.remove('open');
      }
    });

    el.btnResetFilter.addEventListener('click', () => {
      state.filterType = 'all';
      state.sortType = 'rssi';
      document.querySelector('input[name="filter-type"][value="all"]').checked = true;
      document.querySelector('input[name="sort-type"][value="rssi"]').checked = true;
      el.filterIndicator.classList.remove('active');
      el.filterModal.classList.remove('open');
      renderNetworkList();
      showToast('Filters reset to default');
    });

    el.btnApplyFilter.addEventListener('click', () => {
      const selectedFilter = document.querySelector('input[name="filter-type"]:checked');
      const selectedSort = document.querySelector('input[name="sort-type"]:checked');
      if (selectedFilter) state.filterType = selectedFilter.value;
      if (selectedSort) state.sortType = selectedSort.value;

      if (state.filterType !== 'all' || state.sortType !== 'rssi') {
        el.filterIndicator.classList.add('active');
      } else {
        el.filterIndicator.classList.remove('active');
      }

      el.filterModal.classList.remove('open');
      renderNetworkList();
    });

    // Scan Button
    el.btnScanNow.addEventListener('click', triggerScan);

    // Discovery Selector
    el.discoverySelect.addEventListener('change', (e) => {
      selectNetworkForDiscovery(e.target.value);
    });

    // Benchmarks
    if (el.btnRunPing) el.btnRunPing.addEventListener('click', runPingTest);
    if (el.btnRunThroughput) el.btnRunThroughput.addEventListener('click', runThroughputTest);

    // Clear Local Storage
    if (el.btnClearLocalStorage) {
      el.btnClearLocalStorage.addEventListener('click', () => {
        if (confirm('Clear all saved best RSSI records and room labels?')) {
          state.bestRSSI = {};
          state.roomTags = {};
          localStorage.removeItem(STORAGE_BEST_RSSI);
          localStorage.removeItem(STORAGE_ROOM_TAGS);
          showToast('Records cleared');
          renderNetworkList();
          renderDiscoveryView();
        }
      });
    }
  }

  function escapeHtml(str) {
    if (!str) return '';
    return String(str)
      .replace(/&/g, '&amp;')
      .replace(/</g, '&lt;')
      .replace(/>/g, '&gt;')
      .replace(/"/g, '&quot;')
      .replace(/'/g, '&#039;');
  }

  // --- PWA (PROGRESSIVE WEB APP) INSTALLATION & SERVICE WORKER ---
  let deferredInstallPrompt = null;

  function registerServiceWorker() {
    if ('serviceWorker' in navigator) {
      window.addEventListener('load', () => {
        navigator.serviceWorker.register('/sw.js', { scope: '/' })
          .then((reg) => {
            console.log('[PWA] Service Worker registered with scope:', reg.scope);
          })
          .catch((err) => {
            console.warn('[PWA] Service Worker registration failed:', err);
          });
      });
    }
  }

  function initPwaInstallPrompt() {
    const btnInstallPwa = document.getElementById('btn-install-pwa');

    window.addEventListener('beforeinstallprompt', (e) => {
      e.preventDefault();
      deferredInstallPrompt = e;
    });

    window.addEventListener('appinstalled', () => {
      deferredInstallPrompt = null;
      showToast('WΛVΞSCAN shortcut added to home screen!');
    });

    async function triggerInstallFlow() {
      if (deferredInstallPrompt) {
        deferredInstallPrompt.prompt();
        const { outcome } = await deferredInstallPrompt.userChoice;
        if (outcome === 'accepted') {
          showToast('Adding WΛVΞSCAN...');
        }
        deferredInstallPrompt = null;
      } else {
        showToast('To add to home screen: Tap Chrome menu (⋮) -> Create shortcut', 4000);
      }
    }

    if (btnInstallPwa) {
      btnInstallPwa.addEventListener('click', triggerInstallFlow);
    }
  }

  // --- INITIALIZATION ---

  async function init() {
    registerServiceWorker();
    initPwaInstallPrompt();
    loadSavedStorage();
    initEventListeners();

    // Initial data fetch
    await fetchStatus();
    await fetchScanResults();

    // Start background auto-poll (every 3.5 seconds)
    state.autoScanTimer = setInterval(async () => {
      await fetchStatus();
    }, 3500);
  }

  document.addEventListener('DOMContentLoaded', init);
})();
)rawliteral";

const char MANIFEST_JSON[] PROGMEM = R"rawliteral({
  "name": "WΛVΞSCAN — Wi-Fi Analyzer",
  "short_name": "WΛVΞSCAN",
  "description": "Professional Mobile Wi-Fi Analyzer powered by ESP32",
  "start_url": "/",
  "scope": "/",
  "display": "standalone",
  "background_color": "#292929",
  "theme_color": "#292929",
  "orientation": "portrait",
  "categories": ["utilities", "productivity"],
  "icons": [
    {
      "src": "/icons/icon-192.png",
      "sizes": "192x192",
      "type": "image/png",
      "purpose": "any maskable"
    },
    {
      "src": "/icons/icon-512.png",
      "sizes": "512x512",
      "type": "image/png",
      "purpose": "any maskable"
    },
    {
      "src": "/icons/icon.svg",
      "sizes": "any",
      "type": "image/svg+xml",
      "purpose": "any maskable"
    }
  ]
}
)rawliteral";

const char SW_JS[] PROGMEM = R"rawliteral(/**
 * WΛVΞSCAN — Progressive Web App Service Worker
 * Enables offline caching, fast app startup, and native Android home screen install
 */

const CACHE_NAME = 'wavescan-v5';
const STATIC_ASSETS = [
  '/',
  '/style.css',
  '/app.js',
  '/manifest.json',
  '/icons/icon.svg',
  '/icons/icon-192.png',
  '/icons/icon-512.png'
];

// Install Event — Pre-cache static UI shell
self.addEventListener('install', (event) => {
  event.waitUntil(
    caches.open(CACHE_NAME).then((cache) => {
      return cache.addAll(STATIC_ASSETS);
    }).then(() => self.skipWaiting())
  );
});

// Activate Event — Clean up stale caches
self.addEventListener('activate', (event) => {
  event.waitUntil(
    caches.keys().then((keys) => {
      return Promise.all(
        keys.filter((key) => key !== CACHE_NAME).map((key) => caches.delete(key))
      );
    }).then(() => self.clients.claim())
  );
});

// Fetch Event
self.addEventListener('fetch', (event) => {
  const url = new URL(event.request.url);

  // Network-First for dynamic REST APIs (do not cache real-time scan data)
  if (url.pathname.startsWith('/api/')) {
    event.respondWith(
      fetch(event.request).catch(() => {
        return new Response(JSON.stringify({ error: 'offline' }), {
          headers: { 'Content-Type': 'application/json' }
        });
      })
    );
    return;
  }

  // Cache-First with Network fallback for static application assets
  event.respondWith(
    caches.match(event.request).then((cachedResponse) => {
      if (cachedResponse) {
        // Fetch updated version in background
        fetch(event.request).then((networkResponse) => {
          if (networkResponse && networkResponse.status === 200) {
            caches.open(CACHE_NAME).then((cache) => {
              cache.put(event.request, networkResponse);
            });
          }
        }).catch(() => {});
        return cachedResponse;
      }
      return fetch(event.request).then((response) => {
        if (!response || response.status !== 200 || response.type !== 'basic') {
          return response;
        }
        const responseToCache = response.clone();
        caches.open(CACHE_NAME).then((cache) => {
          cache.put(event.request, responseToCache);
        });
        return response;
      });
    })
  );
});
)rawliteral";

const char ICON_SVG[] PROGMEM = R"rawliteral(<svg xmlns="http://www.w3.org/2000/svg" viewBox="0 0 192 192" width="192" height="192">
  <rect width="192" height="192" rx="32" fill="#20232B"/>
  <path d="M96 148c-6.6 0-12 5.4-12 12s5.4 12 12 12 12-5.4 12-12-5.4-12-12-12z" fill="#00C99A"/>
  <path d="M96 112c-18.4 0-35 7.4-47.2 19.5l11.3 11.3C69.4 133.5 82 128 96 128s26.6 5.5 35.9 14.8l11.3-11.3C131 119.4 114.4 112 96 112z" fill="#00C99A"/>
  <path d="M96 76c-28.2 0-53.8 11.4-72.6 30l11.3 11.3C50.6 102 72 92 96 92s45.4 10 61.3 25.3l11.3-11.3C149.8 87.4 124.2 76 96 76z" fill="#20BCEB"/>
  <path d="M96 40C57.8 40 23.3 55.4-2 80.2L9.3 91.5C31.5 69.5 62.2 56 96 56s64.5 13.5 86.7 35.5L194 80.2C168.7 55.4 134.2 40 96 40z" fill="#20BCEB"/>
  <circle cx="96" cy="160" r="8" fill="#EEEEEE"/>
</svg>
)rawliteral";

const size_t ICON_192_PNG_LEN = 1254;
const uint8_t ICON_192_PNG[] PROGMEM = {
  0x89, 0x50, 0x4e, 0x47, 0x0d, 0x0a, 0x1a, 0x0a, 0x00, 0x00, 0x00, 0x0d,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 0x82
};

const size_t ICON_512_PNG_LEN = 6649;
const uint8_t ICON_512_PNG[] PROGMEM = {
  0x89, 0x50, 0x4e, 0x47, 0x0d, 0x0a, 0x1a, 0x0a, 0x00, 0x00, 0x00, 0x0d,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 0x82
};

#endif // WEB_ASSETS_H
